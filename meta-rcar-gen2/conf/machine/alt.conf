## meta-rcar-gen2/conf/machine/alt.conf
```bitbake
#@TYPE: Machine
#@NAME: alt
#@DESCRIPTION: Machine configuration for alt systems

require conf/machine/include/r8a7794.inc
require conf/machine/include/rcar-gen2-providers.inc

MACHINE_EXTRA_RRECOMMENDS = " kernel-modules"

IMAGE_FSTYPES += "tar.bz2"

SERIAL_CONSOLE = "38400 ttySC10"

KERNEL_DEVICETREE = "r8a7794-alt.dtb"

KERNEL_EXTRA_ARGS += "LOADADDR=${UBOOT_ENTRYPOINT}"

UBOOT_MACHINE ?= "alt_vin_config"
UBOOT_ENTRYPOINT = "0x40008000"
UBOOT_LOADADDRESS = "0x40007fc0"

GCCVERSION = "4.9%"
PREFERRED_VERSION_linux-renesas = "3.10%"
PREFERRED_VERSION_linux-libc-headers = "3.10%"
PREFERRED_VERSION_nativesdk-linux-libc-headers = "3.10%"
PREFERRED_VERSION_u-boot = "v2013.01%"

MACHINE_FEATURES = "apm usbgadget usbhost vfat alsa ethernet"
```

## meta-rcar-gen2/conf/machine/include/r8a7791.inc
```bitbake
SOC_FAMILY = "rcar-gen2:r8a7791"
require conf/machine/include/soc-family.inc
DEFAULTTUNE ?= "cortexa15hf-neon"
require conf/machine/include/tune-cortexa15.inc
require ../../../include/multimedia-control.inc

PREFERRED_PROVIDER_virtual/kernel ?= "linux-renesas"
PREFERRED_PROVIDER_linux-libc-headers ?= "linux-libc-headers"
PREFERRED_PROVIDER_nativesdk-linux-libc-headers ?= "nativesdk-linux-libc-headers"
PREFERRED_PROVIDER_u-boot ?= "u-boot"

KERNEL_IMAGETYPE ?= "uImage"
EXTRA_IMAGEDEPENDS += "u-boot"

# multimedia acceleration uses Gst version 1.2.x, otherwise meta-ivi currently uses 1.4.x
PREFERRED_VERSION_gstreamer1.0 = "${@base_conditional("USE_MULTIMEDIA", "1", "1.2.%", "1.4.%", d )}"
PREFERRED_VERSION_gstreamer1.0-omx = "${@base_conditional("USE_MULTIMEDIA", "1", "1.0.%", "1.2.%", d )}"
PREFERRED_VERSION_gstreamer1.0-plugins-bad = '${@base_conditional("USE_MULTIMEDIA", "1", "1.2.%", "1.4.%", d )}'
PREFERRED_VERSION_gstreamer1.0-plugins-base = '${@base_conditional("USE_MULTIMEDIA", "1", "1.2.%", "1.4.%", d )}'
PREFERRED_VERSION_gstreamer1.0-plugins-good = '${@base_conditional("USE_MULTIMEDIA", "1", "1.2.%", "1.4.%", d )}'
PREFERRED_VERSION_gstreamer1.0-plugins-ugly = '${@base_conditional("USE_MULTIMEDIA", "1", "1.2.%", "1.4.%", d )}'
PREFERRED_VERSION_gstreamer1.0-libav = '${@base_conditional("USE_MULTIMEDIA", "1", "1.2.%", "1.4.%", d )}'
```

## meta-rcar-gen2/conf/machine/include/rcar-gen2-providers.inc
```bitbake
# From Intrepid the Genivi Yocto baseline meta-ivi adopted 3.14 as the default kernel for QEMU. 
# Override that to avoid a long list of build messages stating it is switching from 3.14 to 3.10.
PREFERRED_VERSION_linux-yocto ?= "3.10%"

# multimedia acceleration uses Gst version 1.2.x, otherwise meta-ivi currently uses 1.6.x
require ../../../include/multimedia-control.inc

PREFERRED_VERSION_gstreamer1.0 = "${@base_conditional("USE_MULTIMEDIA", "1", "1.2.%", "1.6.%", d )}"
PREFERRED_VERSION_gstreamer1.0-omx = "${@base_conditional("USE_MULTIMEDIA", "1", "1.0.%", "1.2.%", d )}"
PREFERRED_VERSION_gstreamer1.0-plugins-bad = '${@base_conditional("USE_MULTIMEDIA", "1", "1.2.%", "1.6.%", d )}'
PREFERRED_VERSION_gstreamer1.0-plugins-base = '${@base_conditional("USE_MULTIMEDIA", "1", "1.2.%", "1.6.%", d )}'
PREFERRED_VERSION_gstreamer1.0-plugins-good = '${@base_conditional("USE_MULTIMEDIA", "1", "1.2.%", "1.6.%", d )}'
PREFERRED_VERSION_gstreamer1.0-plugins-ugly = '${@base_conditional("USE_MULTIMEDIA", "1", "1.2.%", "1.6.%", d )}'
PREFERRED_VERSION_gstreamer1.0-libav = '${@base_conditional("USE_MULTIMEDIA", "1", "1.2.%", "1.6.%", d )}'
```

## meta-rcar-gen2/conf/machine/koelsch.conf
```bitbake
#@TYPE: Machine
#@NAME: koelsch
#@DESCRIPTION: Machine configuration for koelsch systems

require conf/machine/include/r8a7791.inc
require conf/machine/include/rcar-gen2-providers.inc

MACHINE_EXTRA_RRECOMMENDS = " kernel-modules"

IMAGE_FSTYPES += "tar.bz2"

SERIAL_CONSOLE = "38400 ttySC6"

KERNEL_DEVICETREE = "${S}/arch/arm/boot/dts/r8a7791-koelsch.dts"

KERNEL_EXTRA_ARGS += "LOADADDR=${UBOOT_ENTRYPOINT}"

UBOOT_MACHINE ?= "koelsch_config"
UBOOT_ENTRYPOINT = "0x40008000"
UBOOT_LOADADDRESS = "0x40007fc0"

PREFERRED_VERSION_linux-renesas = "3.10%"
PREFERRED_VERSION_linux-libc-headers = "3.10%"
PREFERRED_VERSION_nativesdk-linux-libc-headers = "3.10%"
PREFERRED_VERSION_u-boot = "v2013.01%"
PREFERRED_VERSION_libdrm = "2.4.45%"

# koelsch multimedia acceleration uses Gst version 1.2.x
PREFERRED_VERSION_gstreamer1.0              = "1.2.%"
PREFERRED_VERSION_gstreamer1.0-plugins-bad  = "1.2.%"
PREFERRED_VERSION_gstreamer1.0-plugins-base = "1.2.%"
PREFERRED_VERSION_gstreamer1.0-plugins-good = "1.2.%"
PREFERRED_VERSION_gstreamer1.0-plugins-ugly = "1.2.%"
PREFERRED_VERSION_gstreamer1.0-libav        = "1.2.%"

MACHINE_FEATURES = "apm usbgadget usbhost vfat alsa ethernet"
```

## meta-rcar-gen2/conf/machine/stout.conf
```bitbake
#@TYPE: Machine
#@NAME: stout
#@DESCRIPTION: Machine configuration for ADAS Starter Kit (Stout) systems

require conf/machine/include/r8a7790.inc
require conf/machine/include/rcar-gen2-providers.inc

MACHINE_EXTRA_RRECOMMENDS = " kernel-modules"

IMAGE_FSTYPES += "tar.bz2"

SERIAL_CONSOLE = "38400 ttySC0"

MACHINEOVERRIDES =. "lcb:"

KERNEL_DEVICETREE = "r8a7790-stout.dtb"

KERNEL_EXTRA_ARGS += "LOADADDR=${UBOOT_ENTRYPOINT}"

UBOOT_MACHINE ?= "r8a7790stout_vin_config"
UBOOT_ENTRYPOINT = "0x40008000"
UBOOT_LOADADDRESS = "0x40007fc0"

GCCVERSION = "4.9%"
PREFERRED_VERSION_linux-renesas = "3.10%"
PREFERRED_VERSION_linux-libc-headers = "3.10%"
PREFERRED_VERSION_nativesdk-linux-libc-headers = "3.10%"
PREFERRED_VERSION_u-boot = "v2013.01%"
PREFERRED_VERSION_libdrm = "2.4.45%"

MACHINE_FEATURES = "apm usbgadget usbhost vfat alsa ethernet"
```
